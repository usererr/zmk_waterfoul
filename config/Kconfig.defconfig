## config/Kconfig.defconfig
```kconfig
# Copyright (c) 2022 The ZMK Contributors
# SPDX-License-Identifier: MIT

if ZMK_DISPLAY

config SPI
    default y

endif # ZMK_DISPLAY

endif
```

## config/nice_nano_v2_defconfig
```kconfig
# SPDX-License-Identifier: MIT

CONFIG_SOC_SERIES_NRF52X=y
CONFIG_SOC_NRF52840_QIAA=y
CONFIG_BOARD_NICE_NANO_V2=y

# Enable MPU
CONFIG_ARM_MPU=y

# Use pinctrl
CONFIG_PINCTRL=y

# enable GPIO
CONFIG_GPIO=y
CONFIG_SPI=y
CONFIG_SPI_0=y
CONFIG_SPI_0_NAME="SPI_0"
CONFIG_SPI_0_OP_MODES=1
CONFIG_SPI_0_IRQ_PRI=1
CONFIG_SPI_NRFX=y
CONFIG_SPI_0_NRF_SPIM=y
CONFIG_SPI_0_NRF_SCK_PIN=1
CONFIG_SPI_0_NRF_MOSI_PIN=2
CONFIG_SPI_0_NRF_MISO_PIN=3
CONFIG_SPI_0_NRF_ORC=0xff

CONFIG_USE_DT_CODE_PARTITION=y
CONFIG_BUILD_OUTPUT_UF2=y

CONFIG_MPU_ALLOW_FLASH_WRITE=y
CONFIG_NVS=y
CONFIG_SETTINGS_NVS=y
CONFIG_FLASH=y
CONFIG_FLASH_PAGE_LAYOUT=y
CONFIG_FLASH_MAP=y
```

## config/west.yml
```yaml
manifest:
  remotes:
    - name: zmkfirmware
      #url-base: https://github.com/zmkfirmware
      url-base: https://github.com/ftc/
  projects:
    - name: zmk
      remote: zmkfirmware
      #revision: main
      revision: mouse-ftc
      import: app/west.yml
  self:
    path: config
```
